## components/board/Kconfig
```kconfig
menu "HillGrow"
    choice HG_ROLE
        prompt "Node role"
        default HG_ROLE_ZONE
        config HG_ROLE_MASTER
            bool "Master"
        config HG_ROLE_ZONE
            bool "Zone"
    endchoice
    config HILLGROW_DEBUG_KEY
        string "Debug unlock key"
        default "hill"
endmenu
```

## components/panel_ui/Kconfig
```kconfig
menu "HillGrow panel UI"
    depends on IDF_TARGET_ESP32P4

    config HILLGROW_PANEL_SD
        bool "Panel microSD card features (firmware install, config export/import)"
        default y
        help
            The panel mounts the microSD card on SDMMC slot 0, beside esp_hosted's C6 link on slot 1 of the same
            controller. This relies on the project's esp_driver_sdmmc override (components/esp_driver_sdmmc), whose
            ISR survives a slot-0 removal. Say n to build a panel that never touches the SDMMC controller: the card
            screens then show "microSD disabled in this build".
endmenu
```
